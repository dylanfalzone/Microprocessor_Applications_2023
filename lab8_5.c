/*
 * lab8_5.c
 *
 * Created: 4/18/2023 11:34:08 AM
 *  Author: dylan
 */ 
#include <avr/io.h>
#include <avr/interrupt.h>
#include "usart.h"

void tcc0_init();
void dac_init();
void dma_init();

volatile uint8_t flag;
uint8_t s_or_t;
volatile uint8_t button;

extern void clock_init(void);

uint16_t sine[256] = {
	0x800,0x832,0x864,0x896,0x8c8,0x8fa,0x92c,0x95e,
	0x98f,0x9c0,0x9f1,0xa22,0xa52,0xa82,0xab1,0xae0,
	0xb0f,0xb3d,0xb6b,0xb98,0xbc5,0xbf1,0xc1c,0xc47,
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	0x670,0x6a1,0x6d3,0x705,0x737,0x769,0x79b,0x7cd
};
uint16_t tri[256] = {
	0x26,0x4d,0x73,0x99,0xc0,0xe6,0x10c,0x133,
	0x159,0x17f,0x1a6,0x1cc,0x1f2,0x218,0x23f,0x265,
	0x28b,0x2b2,0x2d8,0x2fe,0x325,0x34b,0x371,0x398,
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	0x10c,0xe6,0xc0,0x99,0x73,0x4d,0x26,0x0
};

uint8_t index =0;

int main(void)
{	
	//init everything
	clock_init();
	dac_init();
	tcc0_init();
	dma_init();
	usartd0_init2();
	s_or_t = 0;

	while (1)
	{
		if(flag ==1){
			if(button == 0x73){ //s
				//change to triangle
				if(s_or_t == 0){
					s_or_t =1;
					DMA.CH0.CTRLA = ~DMA_CH_ENABLE_bm;
					DMA.CH0.SRCADDR0 = (uint8_t)((uintptr_t)tri);
					DMA.CH0.SRCADDR1 = (uint8_t)(((uintptr_t)tri) >> 8);
					DMA.CH0.SRCADDR2 = (uint8_t)(((uint32_t)((uintptr_t)tri)) >>16);
					DMA.CH0.TRFCNT = (uint16_t)((sizeof(tri)));
					DMA.CH0.CTRLA |= DMA_CH_ENABLE_bm;
					USARTD0.CTRLA = USART_RXCINTLVL_HI_gc;
				}
				//change to sine
				else if(s_or_t ==1){
					s_or_t =0;
					DMA.CH0.CTRLA = ~DMA_CH_ENABLE_bm;
					DMA.CH0.SRCADDR0 = (uint8_t)((uintptr_t)sine);
					DMA.CH0.SRCADDR1 = (uint8_t)(((uintptr_t)sine) >> 8);
					DMA.CH0.SRCADDR2 = (uint8_t)(((uint32_t)((uintptr_t)sine)) >>16);
					DMA.CH0.TRFCNT = (uint16_t)((sizeof(sine)));
					DMA.CH0.CTRLA |= DMA_CH_ENABLE_bm;
					USARTD0.CTRLA = USART_RXCINTLVL_HI_gc;
				}
			}
			else if(button == 0x65) {//e
				TCC0.PER = 125000/1046.50;
				}
			else if(button == 0x34) {//4
				TCC0.PER = 125000/1108.73;
				}
			else if(button == 0x72) {//r
				TCC0.PER = 125000/1174.66;
				}
			else if(button == 0x35) {//5
				TCC0.PER = 125000/1244.51;
				}
			else if(button == 0x74) {//t
				TCC0.PER = 125000/1318.51;
				}
			else if(button == 0x79) {//y
				TCC0.PER = 125000/1396.91;
				}
			else if(button == 0x37) {//7
				TCC0.PER = 125000/1479.98;
				}
			else if(button == 0x75) {//u
				TCC0.PER = 125000/1567.98;
				}
			else if(button == 0x38) {//8
				TCC0.PER = 125000/1661.22;
				}
			else if(button == 0x69) {//i
				TCC0.PER = 125000/1760.00;
				}
			else if(button == 0x39) {//9
				TCC0.PER = 125000/1864.66;
				}
			else if(button == 0x6F) {//0
				TCC0.PER = 125000/1975.53;
				}
			else if(button == 0x70) {//p
				TCC0.PER = 125000/2093.00;
				}
			if(button!= 0x73){
				TCC0.CTRLA = TC_CLKSEL_DIV1_gc;
				TCD0.CTRLA = TC_CLKSEL_DIV256_gc;
			}
			flag =0;
		}
	}
}

void tcc0_init(){
	//tcc0 for timing
	TCC0.PER=0;
	TCC0.CTRLA = TC_CLKSEL_OFF_gc;
	TCC0.CTRLD = TC_EVACT_OFF_gc | TC_EVSEL_CH1_gc;
	//enable event
	EVSYS.CH0MUX = EVSYS_CHMUX_TCC0_OVF_gc;
	
	//tcd0 for interrupts
	TCD0.PER = 6250;
	TCD0.INTCTRLA = TC_OVFINTLVL_HI_gc;
	PMIC.CTRL = PMIC_HILVLEN_bm;
	sei();
	
	
}

void dac_init(){
	//vg
	PORTB.DIRCLR = 0b00000011;
	//CH1
	PORTA.OUTCLR = 0b00001000;
	PORTA.DIRSET = 0b00001000;
	//speaker
	PORTC.OUTSET = 0b10000000;
	PORTC.DIRSET = 0b10000000;
	
	//Just ch1
	DACA.CTRLB = DAC_CHSEL_SINGLE1_gc | DAC_CH1TRIG_bm;
	
	//arefb 2.5v
	DACA.CTRLC = DAC_REFSEL_AREFB_gc;
	
	//channel 0 trigger
	DACA.EVCTRL = 0b00000000;
	
	//CH1 AND ENABLE
	DACA.CTRLA=DAC_CH1EN_bm | DAC_ENABLE_bm;
}

void dma_init(){
	//reset periph
	DMA.CTRL |= DMA_RESET_bm;
	
	//2byte
	DMA.CH0.CTRLA = DMA_CH_SINGLE_bm | DMA_CH_BURSTLEN_2BYTE_gc | DMA_CH_REPEAT_bm;
	
	//source and dest type
	DMA.CH0.ADDRCTRL = DMA_CH_SRCRELOAD_BLOCK_gc | DMA_CH_SRCDIR_INC_gc| 
						DMA_CH_DESTRELOAD_BURST_gc | DMA_CH_DESTDIR_INC_gc;

	//configure trigger
	DMA.CH0.TRIGSRC = DMA_CH_TRIGSRC_EVSYS_CH0_gc;
	
	//source addr
	DMA.CH0.SRCADDR0 = (uint8_t)((uintptr_t)sine);
	DMA.CH0.SRCADDR1 = (uint8_t)(((uintptr_t)sine) >> 8);
	DMA.CH0.SRCADDR2 = (uint8_t)(((uint32_t)((uintptr_t)sine)) >>16);
	
	//dest addr
	DMA.CH0.DESTADDR0 = ((uint16_t)(&DACA.CH1DATA)&0XFF);
	DMA.CH0.DESTADDR1 = ((uint16_t)(&DACA.CH1DATA)&0XFF00) >> 8;
	DMA.CH0.DESTADDR2 = ((uint16_t)(&DACA.CH1DATA)&0XFF0000) >> 16;
	
	//transfer count
	DMA.CH0.TRFCNT = (uint16_t)((sizeof(sine)));
	
	//enable ch0
	DMA.CH0.CTRLA |=DMA_CH_ENABLE_bm;
	
	//enable DMA periph
	DMA.CTRL |= DMA_ENABLE_bm;
}

ISR(TCD0_OVF_vect){
	TCD0.CTRLA = TC_CLKSEL_OFF_gc;
	TCC0.CTRLA = TC_CLKSEL_OFF_gc;
	USARTD0.CTRLA = USART_RXCINTLVL_HI_gc;
}

ISR(USARTD0_RXC_vect){
	button = usartd0_in_char();
	USARTD0.CTRLA = USART_RXCINTLVL_OFF_gc;
	flag = 1;
}

	